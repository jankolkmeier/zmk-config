## boards/shields/betem/Kconfig.defconfig
```kconfig
# Copyright (c) 2020 The ZMK Contributors
# SPDX-License-Identifier: MIT

if SHIELD_BETEM_LEFT || SHIELD_BETEM_RIGHT

config ZMK_SPLIT_ROLE_CENTRAL
    default n

config ZMK_SPLIT
    default y

endif

if SHIELD_BETEM_DONGLE

config ZMK_KEYBOARD_NAME
    default "BETEM Dongle"

config ZMK_SPLIT_ROLE_CENTRAL
    default y

config ZMK_SPLIT
    default y

config ZMK_STUDIO
	default y

config ZMK_SPLIT_BLE_CENTRAL_PERIPHERALS
    default 2

# Set this to ZMK_SPLIT_BLE_CENTRAL_PERIPHERALS + your desired number of BT profiles (default is 5)
config BT_MAX_CONN
    default 6

# Set this to the same number as BT_MAX_CONN
config BT_MAX_PAIRED
    default 6

config ZMK_DONGLE_DISPLAY_DONGLE_BATTERY
    default n

config ZMK_DONGLE_DISPLAY_MAC_MODIFIERS
    default n

config ZMK_DONGLE_DISPLAY_BONGO_CAT
    default n

config ZMK_DONGLE_DISPLAY_MODIFIERS
    default n

config ZMK_DONGLE_DISPLAY_LAYER
    default n

config LV_Z_VDB_SIZE
    default 32

endif
```

## boards/shields/betem/Kconfig.shield
```kconfig
# Copyright (c) 2020 The ZMK Contributors
# SPDX-License-Identifier: MIT

config SHIELD_BETEM_LEFT
    def_bool $(shields_list_contains,betem_left)

config SHIELD_BETEM_RIGHT
    def_bool $(shields_list_contains,betem_right)

config SHIELD_BETEM_DONGLE
    def_bool $(shields_list_contains,betem_dongle)
```
