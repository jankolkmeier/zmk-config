#include <physical_layouts.dtsi>
#include <dt-bindings/zmk/matrix-transform.h>
#include "betem-layouts.dtsi"

&physical_layout0 {
    transform = <&matrix_transform0>;
};

/ {
	chosen {
		zmk,kscan = &kscan0;
        zmk,physical-layout = &physical_layout0;
	};

	kscan0: kscan {
		compatible = "zmk,kscan-gpio-matrix";
		diode-direction = "col2row";
    	wakeup-source;
	};
};